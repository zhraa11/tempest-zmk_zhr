## config/west.yml
```yaml
manifest:
  remotes:
    - name: zmkfirmware
      url-base: https://github.com/zmkfirmware/zmk
  projects:
    - name: zmk
      remote: zmkfirmware
      revision: f96a40733527756f7e4f9b84a923053df28d5462
      import: app/west.yml
  self:
    path: config
```
